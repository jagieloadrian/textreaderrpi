## firmware/esp32/sdkconfig.defaults
```kconfig
CONFIG_ESP_WIFI_SOFTAP_SUPPORT=y
CONFIG_HTTPD_MAX_REQ_HDR_LEN=1024
CONFIG_HTTPD_MAX_URI_LEN=512
CONFIG_WS_TRANSPORT=y
CONFIG_ESP_WEBSOCKET_CLIENT_BUFFER_SIZE=512
```
